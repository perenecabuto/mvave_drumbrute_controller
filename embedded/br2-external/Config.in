## embedded/br2-external/Config.in
```kconfig
menu "MVAVE packages"

source "$BR2_EXTERNAL_MVAVE_PATH/package/python-rtmidi/Config.in"
source "$BR2_EXTERNAL_MVAVE_PATH/package/mvave-drumbrute-controller/Config.in"

endmenu
```

## embedded/br2-external/package/mvave-drumbrute-controller/Config.in
```kconfig
config BR2_PACKAGE_MVAVE_DRUMBRUTE_CONTROLLER
    bool "mvave-drumbrute-controller"

    select BR2_ROOTFS_DEVICE_CREATION_DYNAMIC_DEVTMPFS
    select BR2_PACKAGE_PYTHON3
    select BR2_PACKAGE_HOST_PYTHON3_SSL
    select BR2_PACKAGE_HOST_PYTHON_PIP
    select BR2_PACKAGE_PYTHON_PSUTIL
    select BR2_PACKAGE_SQLITE
    select BR2_PACKAGE_PYTHON3_SQLITE
    select BR2_PACKAGE_PYTHON_RTMIDI
```

## embedded/br2-external/package/python-rtmidi/Config.in
```kconfig
config BR2_PACKAGE_PYTHON_RTMIDI
    bool "python-rtmidi"

    depends on BR2_INSTALL_LIBSTDCPP

    select BR2_PACKAGE_PYTHON3
    select BR2_PACKAGE_HOST_PYTHON3_SSL
    select BR2_PACKAGE_ALSA_LIB
    select BR2_PACKAGE_RTMIDI

    help
      Python bindings for RtMidi
```
